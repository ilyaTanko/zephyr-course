## app/boards/our_board/board.yml
```yaml
board:
  name: our_board
  full_name: Our Board
  vendor: iomico
  socs:
  - name: 'nrf5340'
    variants:
    - name: 'ns'
      cpucluster: 'cpuapp'
```

## app/boards/our_scratch_board/Kconfig.defconfig
```kconfig
if BOARD_OUR_SCRATCH_BOARD

config HW_STACK_PROTECTION
	default ARCH_HAS_STACK_PROTECTION

endif
```

## app/boards/our_scratch_board/Kconfig.our_scratch_board
```kconfig
config BOARD_OUR_SCRATCH_BOARD
	select SOC_NRF52833_QIAA if BOARD_OUR_SCRATCH_BOARD_NRF52833
```

## app/boards/our_scratch_board/board.yml
```yaml
board:
  name: our_scratch_board
  full_name: Our Scratch Board
  vendor: iomico
  socs:
  - name: nrf52833
```

## app/drivers/our_driver/dts/bindings/our_driver.yaml
```yaml
description: Our simple GPIO driver
compatible: "our,driver"
include: base.yaml

properties:
  led:
    type: phandle
    required: true
    description: GPIO LED node controlled by this driver instance.
```

## app/drivers/our_driver/zephyr/Kconfig
```kconfig
config OUR_DRIVER
    bool "Our simple GPIO driver"
    depends on GPIO
    depends on SENSOR
    help
      Enable support for our simple GPIO driver.
```

## tests/ring_buf/testcase.yaml
```yaml
common:
  tags:
    - unit
    - ring_buf
    - ztest
    - homework

tests:
  homework.unit.ring_buf:
    platform_allow:
     - native_sim
     - qemu_x86
    timeout: 180

  homework.unit.ring_buf.ordered:
    platform_allow:
     - native_sim
     - qemu_x86
    timeout: 60
    extra_args: CONFIG_ZTEST_SHUFFLE=n
```
