/dts-v1/;
#include <arm/nordic/nrf5340_cpuapp_ns_qkaa.dtsi>
#include "our_board_cpuapp_common.dtsi"

/ {
	model = "Our Board CPU Application";
	compatible = "iomico,nrf5340-dk-nrf5340-cpuapp";

	chosen {
		zephyr,sram = &sram0_ns_app;
		zephyr,flash = &flash0;
		zephyr,code-partition = &slot0_ns_partition;
	};
};

/* Include default memory partition configuration file */
#include <nordic/nrf5340_cpuapp_ns_partition.dtsi>
